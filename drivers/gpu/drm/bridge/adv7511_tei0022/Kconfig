## drivers/gpu/drm/bridge/adv7511_tei0022/Kconfig
```kconfig
config DRM_I2C_ADV7511_TEI0022
	tristate "ADV7511 tei0022 encoder"
	depends on OF
	select DRM_KMS_HELPER
	select REGMAP_I2C
	help
	  Support for the Analog Device ADV7511(W) encoder for the tei0022 trenz platform.
```
